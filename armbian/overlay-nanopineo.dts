/dts-v1/;
/plugin/;

/ {
    compatible = "friendlyarm,nanopi-neo", "allwinner,sun8i-h3";

    fragment@1 {
        target = <&pio>;
        __overlay__ {
            gpio-line-names =
       /* PA */ "pin11", "", "pin13", "pin15", "", "", "pin12", "",
                "", "", "", "", "", "", "", "",
                "", "", "", "", "", "", "", "",
                "", "", "", "", "", "", "", "",
       /* PB */ "", "", "", "", "", "", "", "",
                "", "", "", "", "", "", "", "",
                "", "", "", "", "", "", "", "",
                "", "", "", "", "", "", "", "",
       /* PC */ "", "", "", "", "", "", "", "",
                "", "", "", "", "", "", "", "",
                "", "", "", "", "", "", "", "",
                "", "", "", "", "", "", "", "",
       /* PD */ "", "", "", "", "", "", "", "",
                "", "", "", "", "", "", "", "",
                "", "", "", "", "", "", "", "",
                "", "", "", "", "", "", "", "",
       /* PE */ "", "", "", "", "", "", "", "",
                "", "", "", "", "", "", "", "",
                "", "", "", "", "", "", "", "",
                "", "", "", "", "", "", "", "",
       /* PF */ "", "", "", "", "", "", "", "",
                "", "", "", "", "", "", "", "",
                "", "", "", "", "", "", "", "",
                "", "", "", "", "", "", "", "",
       /* PG */ "", "", "", "", "", "", "", "",
                "pin16", "pin18", "", "pin7", "", "", "", "",
                "", "", "", "", "", "", "", "",
                "", "", "", "", "", "", "", "";
        };
    };
};
