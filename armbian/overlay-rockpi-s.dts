/dts-v1/;
/plugin/;

/ {
    compatible = "radxa,rockpis", "rockchip,rk3308";

    fragment@0 {
        target = <&gpio0>;
        __overlay__ {
            gpio-line-names =
                /* A */ "", "", "", "", "", "", "", "",
                /* B */ "", "", "", "", "", "", "", "pin11",
                /* C */ "pin13", "pin15", "", "", "", "", "", "",
                /* D */ "", "", "", "", "", "", "", "";
        };
    };

    fragment@1 {
        target = <&gpio2>;
        __overlay__ {
            gpio-line-names =
                "", "", "", "", "pin7", "pin12", "", "",
                "", "pin18", "pin16", "", "", "", "", "",
                "", "", "", "", "", "", "", "",
                "", "", "", "", "", "", "", "";
        };
    };
};
