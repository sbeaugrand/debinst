/dts-v1/;
/plugin/;

/ {
    compatible = "radxa,rockpis", "rockchip,rk3308";

    fragment@0 {
        target = <&uart2>;
        __overlay__ {
            status = "disabled";
        };
    };

    fragment@1 {
        target = <&uart4>;
        __overlay__ {
            status = "disabled";
        };
    };
};
