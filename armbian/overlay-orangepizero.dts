/dts-v1/;
/plugin/;

/ {
    compatible = "xunlong,orangepi-zero", "allwinner,sun8i-h3";

    fragment@1 {
        target = <&pio>;
        __overlay__ {
            gpio-line-names =
       /* PA */ "pin13", "pin11", "", "pin15", "", "", "pin7", "pin12",
                "", "", "", "", "", "", "", "",
                "", "", "pin18", "pin16", "", "", "", "",
                "", "", "", "", "", "", "", "",
       /* PB */ "", "", "", "", "", "", "", "",
                "", "", "", "", "", "", "", "",
                "", "", "", "", "", "", "", "",
                "", "", "", "", "", "", "", "",
       /* PC */ "", "", "", "", "", "", "", "",
                "", "", "", "", "", "", "", "",
                "", "", "", "", "", "", "", "",
                "", "", "", "", "", "", "", "",
       /* PD */ "", "", "", "", "", "", "", "",
                "", "", "", "", "", "", "", "",
                "", "", "", "", "", "", "", "",
                "", "", "", "", "", "", "", "",
       /* PE */ "", "", "", "", "", "", "", "",
                "", "", "", "", "", "", "", "",
                "", "", "", "", "", "", "", "",
                "", "", "", "", "", "", "", "",
       /* PF */ "", "", "", "", "", "", "", "",
                "", "", "", "", "", "", "", "",
                "", "", "", "", "", "", "", "",
                "", "", "", "", "", "", "", "",
       /* PG */ "", "", "", "", "", "", "", "",
                "", "", "", "", "", "", "", "",
                "", "", "", "", "", "", "", "",
                "", "", "", "", "", "", "", "";
        };
    };
};
